## main/Kconfig.projbuild
```kconfig
menu "WiFi Radio Block Configuration"

    config WIFI_SSID
        string "WiFi SSID"
        default "myssid"
        help
            Bench-test fallback SSID. TODO next stage: superseded by the
            SPIFFS-backed single-SSID config store (WIFI.SET over the
            serial CLI) once that lands - this Kconfig value only matters
            until then.

    config WIFI_PASSWORD
        string "WiFi Password"
        default "mypassword"
        help
            Bench-test fallback password. See WIFI_SSID above - same
            caveat applies.

endmenu
```

## sdkconfig.defaults
```kconfig
CONFIG_IDF_TARGET="esp32s3"
CONFIG_ESPTOOLPY_FLASHSIZE_16MB=y
CONFIG_PARTITION_TABLE_CUSTOM=y
CONFIG_SPIRAM=y
CONFIG_SPIRAM_MODE_OCT=y
CONFIG_ESP_IPC_TASK_STACK_SIZE=4096
```
